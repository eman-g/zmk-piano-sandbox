## config/boards/shields/piano/Kconfig.defconfig
```kconfig
# Copyright (c) 2020 The ZMK Contributors
# SPDX-License-Identifier: MIT

config ZMK_BLE
	default y

config ZMK_USB
	default y

if SHIELD_PIANO_NORM

config ZMK_KEYBOARD_NAME
	default "The Sandbox"

endif
```

## config/boards/shields/piano/Kconfig.shield
```kconfig
# Copyright (c) 2020 The ZMK Contributors
# SPDX-License-Identifier: MIT

config SHIELD_PIANO_NORM
	def_bool $(shields_list_contains,piano_norm)
```
